## prj.conf
```kconfig
CONFIG_SERIAL=n
CONFIG_GPIO=y
CONFIG_NRF_DM=y
CONFIG_NEWLIB_LIBC=y
CONFIG_NEWLIB_LIBC_FLOAT_PRINTF=y
CONFIG_DEBUG_INFO=y
CONFIG_NRFX_UARTE0=y
CONFIG_MAIN_STACK_SIZE=4096
```

## src/main.c
```c
//#include <zephyr.h>
//#include <init.h>
#include <nrf.h>
#include <nrfx.h>
#include "nrf_dm.h"
#include "nrfx_config.h"
#include "nrfx_clock.h"
#include "nrfx_uarte.h"
#include <stdint.h>
#include <stdbool.h>

#ifndef TXD_PIN
#define TXD_PIN 6
#endif

#ifndef RXD_PIN
#define RXD_PIN 8
#endif

#include "dm.c"
#include "uart.c"
#include "roles.c"

static nrf_dm_config_t dm_config;
static nrf_dm_report_t dm_report;

int main(void)
{
  dm_clock_init();
  debug_init();
  dm_init();

  int current_role = CMD_NONE; 
  current_role = read_uart_role();

  while(1){
    if (current_role == CMD_INITIATOR){
      current_role = run_initiator();
    } else if (current_role == CMD_REFLECTOR){
      current_role = run_reflector();
    } else if (current_role == CMD_NONE){
      current_role = run_none();
    }
  }
    return 0;
}
```

## src/dm.c
```c
/*********************************************************************
 *        Copyright (c) 2022 Carsten Wulff Software, Norway
 * *******************************************************************
 * Created       : wulff at 2022-5-28
 * *******************************************************************
 *  The MIT License (MIT)
 *
 *  Permission is hereby granted, free of charge, to any person obtaining a copy
 *  of this software and associated documentation files (the "Software"), to
 *deal in the Software without restriction, including without limitation the
 *rights to use, copy, modify, merge, publish, distribute, sublicense, and/or
 *sell copies of the Software, and to permit persons to whom the Software is
 *  furnished to do so, subject to the following conditions:
 *
 *  The above copyright notice and this permission notice shall be included in
 *all copies or substantial portions of the Software.
 *
 *  THE SOFTWARE IS PROVIDED "AS IS", WITHOUT WARRANTY OF ANY KIND, EXPRESS OR
 *  IMPLIED, INCLUDING BUT NOT LIMITED TO THE WARRANTIES OF MERCHANTABILITY,
 *  FITNESS FOR A PARTICULAR PURPOSE AND NONINFRINGEMENT. IN NO EVENT SHALL THE
 *  AUTHORS OR COPYRIGHT HOLDERS BE LIABLE FOR ANY CLAIM, DAMAGES OR OTHER
 *  LIABILITY, WHETHER IN AN ACTION OF CONTRACT, TORT OR OTHERWISE, ARISING
 *FROM, OUT OF OR IN CONNECTION WITH THE SOFTWARE OR THE USE OR OTHER DEALINGS
 *IN THE SOFTWARE.
 *
 ********************************************************************/

#define DBGPIN_1 30
#define DBGPIN_2 31

void debug_init() {

  // Configure GPIO pin as output with standard drive strength.
  NRF_GPIO->PIN_CNF[DBGPIN_2] =
      (GPIO_PIN_CNF_DIR_Output << GPIO_PIN_CNF_DIR_Pos) |
      (GPIO_PIN_CNF_DRIVE_S0S1 << GPIO_PIN_CNF_DRIVE_Pos) |
      (GPIO_PIN_CNF_INPUT_Connect << GPIO_PIN_CNF_INPUT_Pos) |
      (GPIO_PIN_CNF_PULL_Disabled << GPIO_PIN_CNF_PULL_Pos) |
      (GPIO_PIN_CNF_SENSE_Disabled << GPIO_PIN_CNF_SENSE_Pos);

  // Configure GPIO pin as output with standard drive strength.
  NRF_GPIO->PIN_CNF[DBGPIN_1] =
      (GPIO_PIN_CNF_DIR_Output << GPIO_PIN_CNF_DIR_Pos) |
      (GPIO_PIN_CNF_DRIVE_S0S1 << GPIO_PIN_CNF_DRIVE_Pos) |
      (GPIO_PIN_CNF_INPUT_Connect << GPIO_PIN_CNF_INPUT_Pos) |
      (GPIO_PIN_CNF_PULL_Disabled << GPIO_PIN_CNF_PULL_Pos) |
      (GPIO_PIN_CNF_SENSE_Disabled << GPIO_PIN_CNF_SENSE_Pos);

  // NRF_GPIOTE->CONFIG[0] = GPIOTE_CONFIG_MODE_Task | (DBGPIN_2 <<
  // GPIOTE_CONFIG_PSEL_Pos)
  //                         | (GPIOTE_CONFIG_POLARITY_Toggle <<
  //                         GPIOTE_CONFIG_POLARITY_Pos)
  //     | (GPIOTE_CONFIG_OUTINIT_High << GPIOTE_CONFIG_OUTINIT_Pos);

  // NRF_PPI->FORK[0].TEP = (uint32_t)&NRF_GPIOTE->TASKS_OUT[0];
}

static void debug_set(uint32_t pin) { NRF_GPIO->OUTSET = 0x1 << pin; }

static void debug_clear(uint32_t pin) { NRF_GPIO->OUTCLR = 0x1 << pin; }

void debug_start() { debug_set(DBGPIN_2); }

void debug_stop() { debug_clear(DBGPIN_2); }

void dm_init() {
  //- Setup Nordic Distance Toolbox

  uint8_t ppi_ch[2] = {0, 1};
  nrf_dm_ppi_config_t ppi_conf = {
      .ppi_chan_count = 2,
      .ppi_chan = &ppi_ch[0],
  };

  nrf_dm_antenna_config_t ant_cfg = NRF_DM_DEFAULT_SINGLE_ANTENNA_CONFIG;
  nrf_dm_init(&ppi_conf, &ant_cfg, NRF_TIMER1);
}

void debug_pulse(int delay) {
  debug_set(DBGPIN_1);
  volatile int z = 0;
  for (int i = 0; i < delay; i++) {
    z += 1;
  }

  debug_clear(DBGPIN_1);
}

static void m_nrfx_clock_event_handler(nrfx_clock_evt_type_t event) {
  (void)event;
}

void dm_clock_init(void) {
#ifdef NRF_CLOCK_NS
#define NRF_CLOCK NRF_CLOCK_NS
#endif

  nrfx_clock_init(m_nrfx_clock_event_handler);
  nrfx_clock_start(NRF_CLOCK_DOMAIN_HFCLK);

  while (true) {
    nrf_clock_hfclk_t src;
    if (nrfx_clock_is_running(NRF_CLOCK_DOMAIN_HFCLK, &src) &&
        (src == NRF_CLOCK_HFCLK_HIGH_ACCURACY)) {
      break;
    }
  }
}
```

## src/roles.c
```c
enum Role {
    CMD_INITIATOR,
    CMD_REFLECTOR,
    CMD_NONE,
    CMD_UNKNOWN = -1
};

int read_uart_role(void){
    uart_init();
    char role_char;

    if (uart_chars_available()){
        uart_get_char((uint8_t*)&role_char);
        uart_uninit();

        if (role_char == 'i') {
            return CMD_INITIATOR;
        } else if (role_char == 'r') {
            return CMD_REFLECTOR;
        } else if (role_char == 'n') {
            return CMD_NONE;
        } else {
            return CMD_UNKNOWN;
        }
    }
    uart_uninit();
    return CMD_UNKNOWN;  // No new input
}

int run_initiator(void){

    static nrf_dm_config_t dm_config;
    static nrf_dm_report_t dm_report;

    dm_config = NRF_DM_DEFAULT_CONFIG;
    dm_config.role = NRF_DM_ROLE_INITIATOR;
    dm_config.rng_seed = 40;

    while(1){
        // Clear previous result
        dm_report.link_loss = 0;
        dm_report.rssi_local = 0;
        dm_report.rssi_remote = 0;
        dm_report.txpwr_local = 0;
        dm_report.txpwr_remote = 0;
        dm_report.quality = 90;
        dm_report.distance_estimates.mcpd.ifft = 0;
        dm_report.distance_estimates.mcpd.phase_slope = 0;
        dm_report.distance_estimates.mcpd.rssi_openspace = 0;
        dm_report.distance_estimates.mcpd.best = 0;
        for(int i=0;i<80;i++){
        dm_report.iq_tones->i_local[i] =0;
        dm_report.iq_tones->q_local[i] =0;
        dm_report.iq_tones->i_remote[i] =0;
        dm_report.iq_tones->q_remote[i] =0;
        }
        for(int i=0;i<80;i++){
        dm_report.tone_sinr_indicators.sinr_indicator_local[i] =0;
        dm_report.tone_sinr_indicators.sinr_indicator_remote[i] =0;
        }

        // Execute measurement
        nrf_dm_status_t status = nrf_dm_configure(&dm_config);
        debug_start();
        uint32_t timeout_us = 0.5e6;
        status     = nrf_dm_proc_execute(timeout_us);
        debug_stop();

        float distance = 0;
        uint32_t duration = 0;
        uint8_t hopping_sequence[NRF_DM_CHANNEL_MAP_LEN];

        if(status == NRF_DM_STATUS_SUCCESS){
            nrf_dm_populate_report(&dm_report);
            nrf_dm_quality_t quality = nrf_dm_calc(&dm_report);
            duration = nrf_dm_get_duration_us(&dm_config);
            distance = nrf_dm_high_precision_calc(&dm_report);
            nrf_dm_get_hopping_sequence(&dm_config,hopping_sequence);

        } else{  // Failure
       
        dm_report.quality = 100;
        debug_pulse(10);
        }

        //Send report to UART
        uart_init();
        nrf_dm_report_to_json(&dm_report,distance,duration,hopping_sequence);
        uart_uninit();


        // Check for role change after each execution
        int new_role = read_uart_role();
        if (new_role != CMD_UNKNOWN) {
            return new_role; 
        }
    }
}


int run_reflector(void){
    static nrf_dm_config_t dm_config;

    dm_config = NRF_DM_DEFAULT_CONFIG;
    dm_config.role = NRF_DM_ROLE_REFLECTOR;
    dm_config.rng_seed = 40;


    while(1){
        nrf_dm_status_t status = nrf_dm_configure(&dm_config);
        debug_start();
        uint32_t timeout_us = 3e6;
        status = nrf_dm_proc_execute(timeout_us);
        debug_stop();

        if (status == NRF_DM_STATUS_SUCCESS){
            debug_pulse(10);
        } else {
            debug_pulse(5);
        }

        // Check for role change after each execution
        int new_role = read_uart_role();
        if (new_role != CMD_UNKNOWN) {
            return new_role; 
        }
    }
}

int run_none(void){
    static nrf_dm_config_t dm_config;

    dm_config = NRF_DM_DEFAULT_CONFIG;
    dm_config.role = NRF_DM_ROLE_REFLECTOR;
    dm_config.rng_seed = 40;

    nrf_dm_status_t status = nrf_dm_configure(&dm_config);
    while(1){
        // Check for role change after each execution
        int new_role = read_uart_role();
        if (new_role != CMD_UNKNOWN) {
            return new_role; 
        }
    }

}
```
